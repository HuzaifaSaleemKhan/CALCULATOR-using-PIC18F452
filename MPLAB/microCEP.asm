LIST P=PIC18F452=INHX32,N=0,ST=OFF,R=HEX
config OSC=HS,OSCS=OFF,WDT=OFF,BORV=45,PWRT=ON,BOR=ON,DEBUG=OFF,LVP=OFF,STVR=OFF
include<P18F452.inc>
DIGITLO EQU 55H
DIGITHI EQU 56H
LCD_DATA EQU PORTD
LCD_CTRL EQU PORTC
RS EQU RC5
RW EQU RC6
EN EQU RC7
ORG 2AH 

CLRF TRISD
SETF TRISB	
BCF TRISC,5
BCF TRISC,6
BCF TRISC,7
BSF TRISC,0
BSF TRISC,1
BSF TRISC,2
BCF TRISC,3
BCF TRISC,4
MOVLW B'01000011'
MOVWF T0CON
BCF INTCON,TMR0IF

BCF LCD_CTRL,EN
CALL DELAY
MOVLW 38H
CALL COMNWRT
CALL DELAY
MOVLW 0CH
CALL COMNWRT
CALL DELAY
MOVLW 01H
CALL COMNWRT
CALL DELAY
MOVLW 06H
CALL COMNWRT
CALL DELAY

REPEAT

MOVFF PORTB,10H
MOVFF 10H,11H
MOVLW 0FH
ANDWF 10H
MOVLW 0F0H
ANDWF 11H
SWAPF 11H

BTFSS PORTC,0
BRA AB
BTFSS PORTC,1
CALL MULTIPLICATION
BRA AB2 
BRA EXIT
AB
BTFSS PORTC,1
CALL ADDITION
BRA AB1

AB1
BTFSC PORTC,1
CALL SUBTRACTION
BRA EXIT
AB2
BTFSC PORTC,1
CALL DIVISION
BRA EXIT

EXIT
BRA REPEAT

ORG 2010H

ADDITION
MOVLW 080H
CALL COMNWRT
CALL DELAY

CALL DIGILO
CALL ADD
CALL DIGIHI
MOVF 11H,W
ADDWF 10H
MOVFF 10H,20H
CALL COUNT
CALL DISPLAY
MOVLW ' '
CALL DATAWRT
CALL DELAY
MOVLW ' '
CALL DATAWRT
CALL DELAY
MOVLW ' '
CALL DATAWRT
CALL DELAY
MOVLW ' '
CALL DATAWRT
CALL DELAY
RETURN

SUBTRACTION
MOVLW 080H
CALL COMNWRT
CALL DELAY

CALL DIGILO
CALL SUB
CALL DIGIHI	
MOVF 11H,W  
SUBWF 10H
MOVFF 10H,20H
CALL COUNT
CALL DISPLAY
MOVLW ' '
CALL DATAWRT
CALL DELAY
MOVLW ' '
CALL DATAWRT
CALL DELAY
MOVLW ' '
CALL DATAWRT
CALL DELAY
MOVLW ' '
CALL DATAWRT
CALL DELAY
RETURN

MULTIPLICATION
MOVLW 080H
CALL COMNWRT
CALL DELAY

CALL DIGILO
CALL MUL
CALL DIGIHI
MOVF 11H,W
MULWF 10H
MOVF PRODL,W
MOVWF 20H
CALL COUNT
CALL DISPLAY
MOVLW ' '
CALL DATAWRT
CALL DELAY
MOVLW ' '
CALL DATAWRT
CALL DELAY
MOVLW ' '
CALL DATAWRT
CALL DELAY
MOVLW ' '
CALL DATAWRT
CALL DELAY
RETURN

DIVISION
MOVLW 080H
CALL COMNWRT
CALL DELAY
CLRF 02H
CLRF 22H
CLRF 21H

CALL DIGILO
CALL DIV
CALL DIGIHI
MOVFF 11H,21H
MOVFF 11H,22H
DECF 21H
E
MOVF 21H,W
CPFSGT 10H
BRA E1
INCF 02H
MOVF 22H,W
SUBWF 10H
BRA E
E1
MOVFF 02H,20H
CALL COUNT
CALL DISPLAY
MOVLW ' '
CALL DATAWRT
CALL DELAY
MOVLW 'R'
CALL DATAWRT
CALL DELAY
MOVLW '='
CALL DATAWRT
CALL DELAY
MOVF 10H,W
ADDLW 30H
CALL DATAWRT
CALL DELAY
RETURN

COUNT
MOVLW .0
MOVWF DIGITLO
MOVWF DIGITHI
LOOP1
MOVLW .9
CPFSGT 20H
BRA LOOP2
MOVLW .10
SUBWF 20H
INCF DIGITLO
BRA LOOP1
LOOP2
MOVLW .9
CPFSGT DIGITLO
BRA LOOP3
MOVLW .10
SUBWF DIGITLO
INCF DIGITHI
BRA LOOP2
LOOP3
RETURN

DISPLAY
MOVLW 0C0H
CALL COMNWRT
CALL DELAY
CALL DELAY 
MOVLW '='
CALL DATAWRT
CALL DELAY
MOVF DIGITHI,W
ADDLW 30H
CALL DATAWRT
CALL DELAY
MOVF DIGITLO,W
ADDLW 30H
CALL DATAWRT
CALL DELAY
MOVF 20H,W
ADDLW 30H
CALL DATAWRT
CALL DELAY
RETURN


ADD
MOVLW '+'
CALL DATAWRT
CALL DELAY
RETURN


SUB
MOVLW '-'
CALL DATAWRT
CALL DELAY
RETURN


MUL
MOVLW 'X'
CALL DATAWRT
CALL DELAY
RETURN



DIV
MOVLW '/'
CALL DATAWRT
CALL DELAY
RETURN



DIGILO
MOVLW .0
MOVWF 30H
MOVWF 31H
MOVFF 10H,30H
D3
MOVLW .9
CPFSGT 30H
BRA D4
INCF 31H
MOVLW .10
SUBWF 30H
BRA D3
D4
MOVF 31H,W
ADDLW 30H
CALL DATAWRT
CALL DELAY
MOVF 30H,W
ADDLW 30H
CALL DATAWRT
CALL DELAY
RETURN


DIGIHI
MOVLW .0
MOVWF 40H
MOVWF 41H
MOVFF 11H,40H



D1
MOVLW .9
CPFSGT 40H
BRA D2
INCF 41H
MOVLW .10
SUBWF 40H
BRA D1
D2
MOVF 41H,W
ADDLW 30H
CALL DATAWRT
CALL COUNT
CALL DELAY
MOVF 40H,W
ADDLW 30H
CALL DATAWRT
CALL DELAY
RETURN

COMNWRT 
MOVWF LCD_DATA 
BCF LCD_CTRL,RS
BCF LCD_CTRL,RW
BSF LCD_CTRL,EN
CALL DELAY 
BCF LCD_CTRL,EN
RETURN 


DATAWRT 
MOVWF LCD_DATA 
BSF LCD_CTRL,RS
BCF LCD_CTRL,RW
BSF LCD_CTRL,EN
CALL DELAY 
BCF LCD_CTRL,EN
RETURN 


DELAY 
	MOVLW 84H
	MOVWF TMR0L
	

	BSF T0CON,7
S3	BTFSS INTCON,TMR0IF
	BRA S3
	BCF T0CON,7
BCF INTCON,TMR0IF
    RETURN
END